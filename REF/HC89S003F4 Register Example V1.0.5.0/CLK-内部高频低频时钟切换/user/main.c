/**
*   ************************************************************************************
*								上海芯圣电子股份有限公司
*								    www.holychip.cn
*	************************************************************************************
*	@Examle Version		V1.0.5.0
*	@Demo 	Version		V1.0.4.0
*	@Date				2019.12.27
*	************************************************************************************
*									 模块性能介绍
*	MCU有四个时钟源可选，四者都可以作为系统时钟Fosc。
*	Fosc：系统时钟，是Timer，UART，SPI，ADC，PWM的运行时钟。
*		    同时也作为CPU的时钟源 
*	Fcpu：指令执行时钟，也是FLASH擦除时钟。
*	系统上电     （内部高频RC为Fosc时钟源，内部低频RC为看门狗时钟）
*	1、Fcpu为2MHZ。
*	2、Fosc为4MHZ。(Timer、UART、SPI、ADC、PWM)
*	3、看门狗的时钟为44KHZ。
*	************************************************************************************
*									 应用注意事项
*	1、Fcpu最高至20MHz，若Fcpu高于20M，程序会跑飞。
*	2、若进行FLASH读写，必须保证Fcpu为1M-16M范围内的正整数，否则容易擦写失败。
*	3、Fosc频率最高可工作在32MHz。
*	4、Fcpu小于200KHz时，无法程序仿真。
*	5、无法通过端口输出内部高频RC32M，可以输出其他的时钟输出选项。
*	6、内部低频RC做Fosc，高频RC可以在低频RC起振之后关闭。
*	7、在涉及低功耗或IAP的操作时，配置完Fcpu后需要配置FREQ_CLK寄存器指明当前时钟频率，时
*	   钟频率如低于1MHz时，则配置为0x01。
*	************************************************************************************
*  								       客户服务
*	感谢您使用我们的单片机，若发现错误或对函数的使用存在疑问。请添加上海芯圣电子官方QQ群
*	****************************技术支持群：201030494***********************************
*   ************************************************************************************
**/

#define	ALLOCATE_EXTERN
#include "HC89S003F4.h"

void Delay_ms(unsigned int fui_i); //延时函数

unsigned char guc_i = 0;			     //LED翻转次数计数

/***************************************************************************************
  * @实现效果	实现Fosc，Fcpu的内部高频RC与内部低频RC的切换，Fcpu为内部高频RC时，LED1闪
  				    烁较快，Fcpu为内部低频RC时，LED1闪烁较慢。
***************************************************************************************/
void main()
{
/************************************系统初始化****************************************/
	WDTCCR = 0x00;						      //关闭看门狗
		                              //本例程为方便测试关闭看门狗，实际使用中，建议客户打开看门狗，详见WDT复位例程
	CLKSWR = 0x51;						      //选择内部高频RC为系统时钟，内部高频RC 2分频，Fosc=16MHz
	CLKDIV = 0x01;						      //Fosc 1分频得到Fcpu，Fcpu=16MHz 
/**********************************相关配置初始化**************************************/
	P0M0 = P0M0&0xF0|0x08;		      //P00设置为推挽输出

	while(1)
	{
		for(guc_i=10;guc_i>0;guc_i--)
		{
			P0_0 =~ P0_0;   		       	//P00取反	
			Delay_ms(250);
		}
		while((CLKCON&0x10)!=0x10);		//等待内部低频RC起振
		CLKSWR &=~ 0x30;				      //将Fcpu切换为为内部低频RC
		while((CLKSWR&0xC0)!=0x00);		//等待系统时钟切换内部低频RC完成
		CLKCON &=~ 0x02;				      //关闭内部高频RC
		for(guc_i=10;guc_i>0;guc_i--)
		{
			P0_0 =~ P0_0;   			      //对P00取反	
			Delay_ms(10);
		}
		CLKCON |= 0x02;					      //打开内部高频RC
		while((CLKCON&0x20)!=0x20);		//等待内部高频RC起振
		CLKSWR = 0x51;					      //选择内部高频RC为Fosc，内部高频RC 2分频，Fosc=16MHz
		while((CLKSWR&0xC0)!=0x40);		//等待系统时钟切换内部高频RC完成
		CLKDIV = 0x01;					      //Fosc 1分频得到Fcpu，Fcpu=16MHz 
	}
}

/**
  * @说明  	延时函数
  * @参数  	fui_i : 延时时间
  * @返回值 无
  * @注 	  Fcpu = 16MHz，fui_i = 1时，延时时间约为1Ms
  */
void Delay_ms(unsigned int fui_i)
{
	unsigned int fui_j;
	for(;fui_i > 0;fui_i --)
	for(fui_j = 1596;fui_j > 0;fui_j --);
}
